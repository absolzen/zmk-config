## config/west.yml
```yaml
manifest:
  remotes:
    - name: zmkfirmware
      url-base: https://github.com/zmkfirmware
    - name: absolzen
      url-base: https://github.com/absolzen
    - name: urob
      url-base: https://github.com/urob
  projects:
    - name: zmk
      remote: absolzen
      revision: main
      import: app/west.yml
    - name: zmk-helpers
      remote: urob
      revision: v2
  self:
      path: config
```
